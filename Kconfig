## Kconfig
```kconfig
menu "Joylink"

    menu "Joylink_light"
        config JOYLINK_LIGHT_R
            default "25"
            int "the GPIO of light_Red"
        
        config JOYLINK_LIGHT_G
            default "26"
            int "the GPIO of light_green"
        
        config JOYLINK_LIGHT_B
            default "27"
            int "the GPIO of light_blue"
    endmenu

config JOYLINK_DEVICE_UUID
    default "972212"
    string "The device uuid, you can get it from Joylink"

config JOYLINK_PUBLIC_KEY
    default "035CAF2E8DDD4B5667DD2199E3809615BA84E5D8FDDE7B5F9A3310D476EC52ED7C"
    string "The public key, you can get it from JD"

config JOYLINK_DEVICE_MAC
    default "240AAEEBCF20"
    string "DEVICE MAC"

config JOYLINK_PRIVATE_KEY
    default "6F5111A86101EECCCF6CB791FDD447E6DBC953F73E30D4BB3826527C4BBF50F3"
    string "The private key, you can get it from JD"

config JOYLINK_DEVICE_BRAND
    default "549"
    string "The brand of the product,you can get it from JD"
	
config JOYLINK_DEVICE_CID
    default "102009"
    string "The category of the product,you can get it from JD"
    
config JOYLINK_SOFTAP_ENABLE
    bool "Enabe Joylink softap configure wifi"
	default y

config JOYLINK_SOFTAP_SSID
    default "JDDeng9141"
    string "The SoftAP SSID"
        depends on JOYLINK_SOFTAP_ENABLE

config JOYLINK_BLE_ENABLE
    bool "Whether or not use Joylink ble configure wifi"
    default n
        depends on IDF_TARGET_ESP32
endmenu
```

## example/main/Kconfig
```kconfig
menu "Joylink"
config JOYLINK_ENABLE
	bool "Enabe Joylink"
	default y

config JOYLINK_SMNT_BUTTON_NUM
    int "the io number for smnt configure network"
    default 14
	depends on JOYLINK_ENABLE
    
config JOYLINK_RESET_BUTTON_NUM
    int "the io number for reset"
    default 15
	depends on JOYLINK_ENABLE

config JOYLINK_SOFTAP_BUTTON_NUM
    int "the io number for softap configure network"
    default 16
	depends on JOYLINK_ENABLE
config JOYLINK_DEVICE_UUID
    string "The device uuid, you can get it from Joylink"
        depends on JOYLINK_ENABLE

config JOYLINK_SMNT_AES_KEY
    string "The secret key for smnt, you can get it from Joylink"
        depends on JOYLINK_ENABLE

config JOYLINK_PUBLIC_KEY
    string "The public key, you can get it from Joylink"
        depends on JOYLINK_ENABLE

config JOYLINK_SOFTAP_ENABLE
    bool "Enabe Joylink softap configure wifi"
	default y
	depends on JOYLINK_ENABLE

config JOYLINK_SOFTAP_PACKET_HEAD
    string "The header of the SoftAP SSID"
        depends on JOYLINK_SOFTAP_ENABLE

config JOYLINK_DEVICE_BRAND
    string "The brand of the product,you can get it from Joylink, and it should be 4 characters"
        depends on JOYLINK_SOFTAP_ENABLE
	
config JOYLINK_DEVICE_CID
    string "The category of the product,you can get it from Joylink, and it should be 4 characters"
        depends on JOYLINK_SOFTAP_ENABLE

endmenu
```

## example_project/main/Kconfig
```kconfig
menu "Joylink"

config JOYLINK_DEVICE_UUID
    default "972212"
    string "The device uuid, you can get it from Joylink"

config JOYLINK_SMNT_AES_KEY
    default "HCDV8W2K57BUN2C5"
    string "The secret key for smnt, you can get it from Joylink"

config JOYLINK_PUBLIC_KEY
    default "035CAF2E8DDD4B5667DD2199E3809615BA84E5D8FDDE7B5F9A3310D476EC52ED7C"
    string "The public key, you can get it from JD"

config JOYLINK_DEVICE_MAC
    default "240AAEEBCF18"
    string "DEVICE MAC"

config JOYLINK_PRIVATE_KEY
    default "B1120284273A1686E9B518FA49248CFA65C8D229581BB075860EFD895829C089"
    string "The private key, you can get it from JD"

config JOYLINK_DEVICE_BRAND
    default "549"
    string "The brand of the product,you can get it from JD"
	
config JOYLINK_DEVICE_CID
    default "102009"
    string "The category of the product,you can get it from JD"
    
config JOYLINK_SOFTAP_ENABLE
    bool "Enabe Joylink softap configure wifi"
	default y

config JOYLINK_SOFTAP_SSID
    default "JDDeng9141"
    string "The SoftAP SSID"
        depends on JOYLINK_SOFTAP_ENABLE

endmenu
```

## example_project/sdkconfig.defaults
```kconfig
#
# Partition Table
#

CONFIG_PARTITION_TABLE_CUSTOM=y
CONFIG_PARTITION_TABLE_CUSTOM_FILENAME="joylink_demo.csv"

#
# PThreads
#
CONFIG_ENABLE_PTHREAD=y
```

## examples/light_demo/default_configs/esp32/sdkconfig.defaults
```kconfig
#
# Serial flasher config
#
CONFIG_ESPTOOLPY_FLASHMODE_QIO=y
CONFIG_ESPTOOLPY_FLASHSIZE_4MB=y

#
# Partition Table
#
CONFIG_PARTITION_TABLE_CUSTOM=y
CONFIG_PARTITION_TABLE_CUSTOM_FILENAME="default_configs/esp32/joylink_demo.csv"
CONFIG_PARTITION_TABLE_FILENAME="default_configs/esp32/joylink_demo.csv"

#
# Bluetooth
#
CONFIG_BT_ENABLED=y

#
# Bluetooth controller
#
CONFIG_BTDM_CTRL_MODE_BLE_ONLY=y

#
# Wi-Fi
#
CONFIG_ESP32_WIFI_SW_COEXIST_ENABLE=y

CONFIG_JOYLINK_BLE_ENABLE=n

#
# Light GPIO
#
CONFIG_JOYLINK_LIGHT_R=25
CONFIG_JOYLINK_LIGHT_G=26
CONFIG_JOYLINK_LIGHT_B=27

#
# ESP-TLS
#
CONFIG_ESP_TLS_INSECURE=y
CONFIG_ESP_TLS_SKIP_SERVER_CERT_VERIFY=y
```

## examples/light_demo/default_configs/esp32c3/sdkconfig.defaults
```kconfig
#
# Serial flasher config
#
CONFIG_ESPTOOLPY_FLASHMODE_QIO=y
CONFIG_ESPTOOLPY_FLASHSIZE_4MB=y

#
# Partition Table
#
CONFIG_PARTITION_TABLE_CUSTOM=y
CONFIG_PARTITION_TABLE_CUSTOM_FILENAME="default_configs/esp32c3/joylink_demo.csv"
CONFIG_PARTITION_TABLE_FILENAME="default_configs/esp32c3/joylink_demo.csv"

#
# Wi-Fi
#
CONFIG_ESP32_WIFI_SW_COEXIST_ENABLE=y

#
# Bluetooth
#
CONFIG_BT_ENABLED=y

#
# Bluetooth controller
#
CONFIG_BT_BLE_42_FEATURES_SUPPORTED=y
CONFIG_BT_BLE_50_FEATURES_SUPPORTED=n

#
# Light GPIO
#
CONFIG_JOYLINK_LIGHT_R=5
CONFIG_JOYLINK_LIGHT_G=6
CONFIG_JOYLINK_LIGHT_B=7

#
# ESP-TLS
#
CONFIG_ESP_TLS_INSECURE=y
CONFIG_ESP_TLS_SKIP_SERVER_CERT_VERIFY=y
```

## examples/light_demo/default_configs/esp32s2/sdkconfig.defaults
```kconfig
#
# Serial flasher config
#
CONFIG_ESPTOOLPY_FLASHMODE_QIO=y
CONFIG_ESPTOOLPY_FLASHSIZE_4MB=y

#
# Partition Table
#
CONFIG_PARTITION_TABLE_CUSTOM=y
CONFIG_PARTITION_TABLE_CUSTOM_FILENAME="default_configs/esp32s2/joylink_demo.csv"
CONFIG_PARTITION_TABLE_FILENAME="default_configs/esp32s2/joylink_demo.csv"

#
# Wi-Fi
#
CONFIG_ESP32_WIFI_SW_COEXIST_ENABLE=y

#
# Light GPIO
#
CONFIG_JOYLINK_LIGHT_R=15
CONFIG_JOYLINK_LIGHT_G=16
CONFIG_JOYLINK_LIGHT_B=17

#
# ESP-TLS
#
CONFIG_ESP_TLS_INSECURE=y
CONFIG_ESP_TLS_SKIP_SERVER_CERT_VERIFY=y
```

## examples/light_demo/default_configs/esp32s3/sdkconfig.defaults
```kconfig
#
# Serial flasher config
#
CONFIG_ESPTOOLPY_FLASHMODE_QIO=y
CONFIG_ESPTOOLPY_FLASHSIZE_4MB=y

#
# Partition Table
#
CONFIG_PARTITION_TABLE_CUSTOM=y
CONFIG_PARTITION_TABLE_CUSTOM_FILENAME="default_configs/esp32s3/joylink_demo.csv"
CONFIG_PARTITION_TABLE_FILENAME="default_configs/esp32s3/joylink_demo.csv"

#
# Wi-Fi
#
CONFIG_ESP32_WIFI_SW_COEXIST_ENABLE=y

#
# Bluetooth
#
CONFIG_BT_ENABLED=y

#
# Bluetooth controller
#
CONFIG_BT_BLE_42_FEATURES_SUPPORTED=y
CONFIG_BT_BLE_50_FEATURES_SUPPORTED=n

#
# Light GPIO
#
CONFIG_JOYLINK_LIGHT_R=15
CONFIG_JOYLINK_LIGHT_G=16
CONFIG_JOYLINK_LIGHT_B=17

#
# ESP-TLS
#
CONFIG_ESP_TLS_INSECURE=y
CONFIG_ESP_TLS_SKIP_SERVER_CERT_VERIFY=y
```

## examples/light_demo/default_configs/esp8266/sdkconfig.defaults
```kconfig
#
# Serial flasher config
#
CONFIG_ESPTOOLPY_FLASHMODE_QIO=y
CONFIG_ESPTOOLPY_FLASHSIZE_2MB=y

#
# Partition Table
#
CONFIG_PARTITION_TABLE_CUSTOM=y
CONFIG_PARTITION_TABLE_CUSTOM_FILENAME="default_configs/esp8266/joylink_demo.csv"
CONFIG_PARTITION_TABLE_FILENAME="default_configs/esp8266/joylink_demo.csv"


CONFIG_ENABLE_PTHREAD=y

CONFIG_MBEDTLS_SSL_IN_CONTENT_LEN=4096
CONFIG_MBEDTLS_KEY_EXCHANGE_DHE_RSA=n
CONFIG_MBEDTLS_KEY_EXCHANGE_ELLIPTIC_CURVE=n
CONFIG_MBEDTLS_KEY_EXCHANGE_ECDHE_RSA=n
CONFIG_MBEDTLS_KEY_EXCHANGE_ECDHE_ECDSA=n
CONFIG_MBEDTLS_KEY_EXCHANGE_ECDH_ECDSA=n
CONFIG_MBEDTLS_KEY_EXCHANGE_ECDH_RSA=n

CONFIG_NEWLIB_NANO_FORMAT=n

#
# Light GPIO
#
CONFIG_JOYLINK_LIGHT_R=4
CONFIG_JOYLINK_LIGHT_G=5
CONFIG_JOYLINK_LIGHT_B=15
```

## examples/light_demo/main/Kconfig
```kconfig
menu "Joylink"

config JOYLINK_SMNT_BUTTON_NUM
    int "the io number for smnt configure network"
    default 14
    
config JOYLINK_RESET_BUTTON_NUM
    int "the io number for reset"
    default 15

config JOYLINK_SOFTAP_BUTTON_NUM
    int "the io number for softap configure network"
    default 16

config JOYLINK_DEVICE_UUID
    string "The device uuid, you can get it from Joylink"

config JOYLINK_SMNT_AES_KEY
    string "The secret key for smnt, you can get it from Joylink"

config JOYLINK_PUBLIC_KEY
    default "02F325ACDDD9A3EBF0B4BAE97B0E8E0BF3E781031E06B06C4B27B42FFBBE0FD2C0"
    string "The public key, you can get it from Joylink"

config JOYLINK_DEVICE_MAC
    default "240AAEEBCF01"
    string "DEVICE MAC"

config JOYLINK_PRIVATE_KEY
    string "The private key, you can get it from Joylink"

config JOYLINK_SOFTAP_ENABLE
    bool "Enabe Joylink softap configure wifi"
	default y

config JOYLINK_SOFTAP_PACKET_HEAD
    string "The header of the SoftAP SSID"
        depends on JOYLINK_SOFTAP_ENABLE

config JOYLINK_DEVICE_BRAND
    string "The brand of the product,you can get it from Joylink, and it should be 4 characters"
        depends on JOYLINK_SOFTAP_ENABLE
	
config JOYLINK_DEVICE_CID
    string "The category of the product,you can get it from Joylink, and it should be 4 characters"
        depends on JOYLINK_SOFTAP_ENABLE

endmenu
```
